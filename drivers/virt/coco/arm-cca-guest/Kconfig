## drivers/virt/coco/arm-cca-guest/Kconfig
```kconfig
# SPDX-License-Identifier: GPL-2.0-only
#

config ARM_CCA_GUEST
	tristate "Arm CCA Guest driver"
	depends on ARM_RMM_RSI
	depends on HAVE_ARM_SMCCC_DISCOVERY
	select PCI_TSM if PCI
	select CRYPTO_LIB_SHA256
	select CRYPTO_LIB_SHA512
	select TSM_REPORTS
	help
	  The driver provides userspace interface to request an
	  attestation report from the Realm Management Monitor(RMM).
	  If the DA feature is supported, it also register with TSM framework.

	  If you choose 'M' here, this module will be called
	  arm-cca-guest.
```

## drivers/virt/coco/arm-cca-host/Kconfig
```kconfig
# SPDX-License-Identifier: GPL-2.0-only
#
# TSM (TEE Security Manager) host drivers
#
config ARM_CCA_HOST
	tristate "Arm CCA Host driver"
	depends on ARM64
	depends on PCI
	depends on ARM_RMM_RMI
	depends on HAVE_ARM_SMCCC_DISCOVERY
	select PCI_TSM
	select KEYS
	select ASYMMETRIC_KEY_TYPE
	select ASYMMETRIC_PUBLIC_KEY_SUBTYPE
	select CRYPTO
	select X509_CERTIFICATE_PARSER
	select CRYPTO_ECDSA
	select CRYPTO_RSA

	help
	  ARM CCA RMM firmware is the trusted runtime that enforces memory
	  isolation and security for confidential computing on ARM. This driver
	  provides the interface for communicating with RMM to support secure
	  device assignment.

	  If you choose 'M' here, this module will be called arm-cca-host.
```

## drivers/virt/coco/tdx-host/Kconfig
```kconfig
config TDX_HOST_SERVICES
	tristate
	depends on INTEL_TDX_HOST
	depends on PCI
	select FW_LOADER
	select FW_UPLOAD
	select PCI_TSM
	default m
```
